## firmware/siena-jc3248w535/main/Kconfig.projbuild
```kconfig
menu "Psion Siena"

    config SIENA_LANGUAGE
        int "Locale the ROM boots in"
        range 0 3
        default 0
        help
            The v4.20f Siena ROM carries four locales, picked at boot by
            board straps: 0 English (UK), 1 English (USA), 2 Swedish,
            3 Spanish.

    config SIENA_SCREEN_FLIPPED
        bool "Turn the picture upside down"
        default n
        help
            Rotate the Siena screen 180 degrees, for when the panel sits in
            the case the other way round.

endmenu
```
