// SPDX-License-Identifier: LicenseRef-PsionWebEmulator
// Copyright (c) 2024-2026 Joe Haines <joehaines@gmail.com>. See LICENSE.

#include "lcd_axs15231b.h"

#include "board.h"

#include "driver/ledc.h"
#include "driver/spi_master.h"
#include "esp_heap_caps.h"
#include "esp_lcd_io_spi.h"
#include "esp_log.h"
#include "freertos/task.h"

namespace {

const char *TAG = "lcd";

constexpr spi_host_device_t kHost = SPI2_HOST;
constexpr uint32_t kPixelClockHz = 40 * 1000 * 1000;

// QSPI framing: the command byte rides in bits 8-15 of a 32-bit "command"
// whose top byte is the transfer opcode (0x02 register write, 0x32 pixel
// data on four lines).
constexpr uint32_t kOpWriteCmd   = 0x02;
constexpr uint32_t kOpWriteColor = 0x32;

constexpr uint8_t kCmdSwReset = 0x01, kCmdSleepOut = 0x11, kCmdDisplayOn = 0x29;
constexpr uint8_t kCmdCaset = 0x2A, kCmdRamwr = 0x2C, kCmdRamwrc = 0x3C;
constexpr uint8_t kCmdMadctl = 0x36, kCmdColmod = 0x3A;

struct InitCmd { uint8_t cmd; uint8_t data[31]; uint8_t len; uint16_t delayMs; };

// The JC3248W535's own panel set-up (lcd_init_cmds in the vendor BSP,
// src/esp_bsp.c of github.com/NorthernMan54/JC3248W535EN; CC0-1.0). The
// AXS15231B's power, gamma and timing registers are panel-specific, so
// these are used verbatim.
const InitCmd kInitCmds[] = {
    {0xBB, {0x00, 0x00, 0x00, 0x00, 0x00, 0x00, 0x5A, 0xA5}, 8, 0},
    {0xA0, {0xC0, 0x10, 0x00, 0x02, 0x00, 0x00, 0x04, 0x3F, 0x20, 0x05, 0x3F, 0x3F, 0x00, 0x00, 0x00, 0x00, 0x00}, 17, 0},
    {0xA2, {0x30, 0x3C, 0x24, 0x14, 0xD0, 0x20, 0xFF, 0xE0, 0x40, 0x19, 0x80, 0x80, 0x80, 0x20, 0xF9, 0x10, 0x02, 0xFF, 0xFF, 0xF0, 0x90, 0x01, 0x32, 0xA0, 0x91, 0xE0, 0x20, 0x7F, 0xFF, 0x00, 0x5A}, 31, 0},
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    {0xBB, {0x00, 0x00, 0x00, 0x00, 0x00, 0x00, 0x00, 0x00}, 8, 0},
    {0x13, {}, 0, 0},
    {0x11, {}, 0, 120},
    {0x2C, {0x00, 0x00, 0x00, 0x00}, 4, 0},
};

constexpr ledc_channel_t kBacklightChannel = LEDC_CHANNEL_1;

} // namespace

void Lcd::command(uint8_t cmd, const uint8_t *data, size_t len) {
    ESP_ERROR_CHECK(esp_lcd_panel_io_tx_param(
        m_io, int((kOpWriteCmd << 24) | (uint32_t(cmd) << 8)), data, len));
}

bool Lcd::onTransferDone(esp_lcd_panel_io_handle_t, esp_lcd_panel_io_event_data_t *,
                         void *ctx) {
    BaseType_t woken = pdFALSE;
    xSemaphoreGiveFromISR(static_cast<Lcd *>(ctx)->m_free, &woken);
    return woken == pdTRUE;
}

esp_err_t Lcd::init() {
    // Backlight off until the first frame is up, so power-on garbage in
    // the panel's frame memory never shows.
    ledc_timer_config_t timer = {};
    timer.speed_mode = LEDC_LOW_SPEED_MODE;
    timer.duty_resolution = LEDC_TIMER_10_BIT;
    timer.timer_num = LEDC_TIMER_1;
    timer.freq_hz = 5000;
    timer.clk_cfg = LEDC_AUTO_CLK;
    ESP_ERROR_CHECK(ledc_timer_config(&timer));
    ledc_channel_config_t channel = {};
    channel.gpio_num = board::kLcdBacklight;
    channel.speed_mode = LEDC_LOW_SPEED_MODE;
    channel.channel = kBacklightChannel;
    channel.timer_sel = LEDC_TIMER_1;
    channel.duty = 0;
    ESP_ERROR_CHECK(ledc_channel_config(&channel));

    spi_bus_config_t bus = {};
    bus.sclk_io_num = board::kLcdClk;
    bus.data0_io_num = board::kLcdD0;
    bus.data1_io_num = board::kLcdD1;
    bus.data2_io_num = board::kLcdD2;
    bus.data3_io_num = board::kLcdD3;
    bus.data4_io_num = bus.data5_io_num = bus.data6_io_num = bus.data7_io_num = -1;
    bus.max_transfer_sz = kWidth * kStripRows * 2;
    ESP_ERROR_CHECK(spi_bus_initialize(kHost, &bus, SPI_DMA_CH_AUTO));

    m_free = xSemaphoreCreateCounting(2, 2);
    esp_lcd_panel_io_spi_config_t io = {};
    io.cs_gpio_num = board::kLcdCs;
    io.dc_gpio_num = GPIO_NUM_NC;
    io.spi_mode = 3;
    io.pclk_hz = kPixelClockHz;
    io.trans_queue_depth = 4;
    io.on_color_trans_done = &Lcd::onTransferDone;
    io.user_ctx = this;
    io.lcd_cmd_bits = 32;
    io.lcd_param_bits = 8;
    io.flags.quad_mode = 1;
    ESP_ERROR_CHECK(esp_lcd_new_panel_io_spi(esp_lcd_spi_bus_handle_t(kHost), &io, &m_io));

    for (auto &strip : m_strip) {
        strip = static_cast<uint16_t *>(heap_caps_malloc(
            kWidth * kStripRows * 2, MALLOC_CAP_DMA | MALLOC_CAP_INTERNAL));
        if (!strip) return ESP_ERR_NO_MEM;
    }

    // No reset line on this board: software reset, then the vendor set-up.
    command(kCmdSwReset);
    vTaskDelay(pdMS_TO_TICKS(120));
    command(kCmdSleepOut);
    vTaskDelay(pdMS_TO_TICKS(100));
    const uint8_t madctl = 0x00, colmod = 0x55;    // RGB order, 16 bpp
    command(kCmdMadctl, &madctl, 1);
    command(kCmdColmod, &colmod, 1);
    for (const InitCmd &c : kInitCmds) {
        command(c.cmd, c.len ? c.data : nullptr, c.len);
        if (c.delayMs) vTaskDelay(pdMS_TO_TICKS(c.delayMs));
    }
    command(kCmdDisplayOn);
    ESP_LOGI(TAG, "AXS15231B up, %dx%d", kWidth, kHeight);
    return ESP_OK;
}

void Lcd::setBacklight(int percent) {
    percent = percent < 0 ? 0 : (percent > 100 ? 100 : percent);
    ledc_set_duty(LEDC_LOW_SPEED_MODE, kBacklightChannel, uint32_t(1023 * percent / 100));
    ledc_update_duty(LEDC_LOW_SPEED_MODE, kBacklightChannel);
}

void Lcd::drawFrame(const std::function<void(int, int, uint16_t *)> &fill) {
    // tx_param waits for queued pixel transfers, so the column window is
    // set only after the previous frame has fully gone out.
    const uint8_t caset[4] = { 0, 0, uint8_t((kWidth - 1) >> 8), uint8_t((kWidth - 1) & 0xFF) };
    command(kCmdCaset, caset, sizeof caset);
    for (int row = 0, n = 0; row < kHeight; row += kStripRows, ++n) {
        xSemaphoreTake(m_free, portMAX_DELAY);
        uint16_t *buf = m_strip[n & 1];
        fill(row, kStripRows, buf);
        const uint8_t cmd = row == 0 ? kCmdRamwr : kCmdRamwrc;
        ESP_ERROR_CHECK(esp_lcd_panel_io_tx_color(
            m_io, int((kOpWriteColor << 24) | (uint32_t(cmd) << 8)), buf,
            size_t(kWidth) * kStripRows * 2));
    }
}
